## buildroot-external/Config.in
```kconfig
menu "Zynq-7020 FPGA + Embedded Linux packages"
source "$BR2_EXTERNAL_ZYNQ7020_PATH/package/fft-dma-uapi/Config.in"
source "$BR2_EXTERNAL_ZYNQ7020_PATH/package/fft-dma-driver/Config.in"
source "$BR2_EXTERNAL_ZYNQ7020_PATH/package/fft-dma-test/Config.in"
source "$BR2_EXTERNAL_ZYNQ7020_PATH/package/fft-ethernet-server/Config.in"
endmenu
```

## buildroot-external/package/fft-dma-bench/Config.in
```kconfig
config BR2_PACKAGE_FFT_DMA_BENCH
	bool "fft-dma-bench"
	depends on BR2_PACKAGE_FFT_DMA_DRIVER
	help
	  DMAengine latency, throughput, and repeated-transfer stress test.
```

## buildroot-external/package/fft-dma-driver/Config.in
```kconfig
config BR2_PACKAGE_FFT_DMA_DRIVER
	bool "fft-dma-driver"
	depends on BR2_LINUX_KERNEL
	select BR2_PACKAGE_FFT_DMA_UAPI
	help
	  Kernel platform driver for the Zynq-7020 AXI DMA FFT accelerator.
```

## buildroot-external/package/fft-dma-test/Config.in
```kconfig
config BR2_PACKAGE_FFT_DMA_TEST
	bool "fft-dma-test"
	depends on BR2_PACKAGE_FFT_DMA_DRIVER
	help
	  Userspace ioctl validation for the simulated 100 MSPS FFT input.
```

## buildroot-external/package/fft-dma-uapi/Config.in
```kconfig
config BR2_PACKAGE_FFT_DMA_UAPI
	bool
	help
	  Shared ioctl ABI for the FFT DMA kernel driver and user-space clients.
```

## buildroot-external/package/fft-ethernet-server/Config.in
```kconfig
config BR2_PACKAGE_FFT_ETHERNET_SERVER
	bool "fft-ethernet-server"
	depends on BR2_USE_MMU
	depends on BR2_PACKAGE_FFT_DMA_DRIVER
	depends on BR2_PACKAGE_FFT_DMA_BENCH
	help
	  Direct Ethernet TCP endpoint for the FFT DMA driver.
```
